## csi-presence/main/Kconfig.projbuild
```kconfig
menu "csi presence"

config ESP_WIFI_SSID
    string "ssid"
    default "myssid"

config ESP_WIFI_PASSWORD
    string "password"
    default "mypassword"

endmenu
```

## csi-presence/sdkconfig.defaults
```kconfig
CONFIG_IDF_TARGET="esp32s3"
CONFIG_ESP_WIFI_CSI_ENABLED=y
CONFIG_ESP_WIFI_STATIC_RX_BUFFER_NUM=16
CONFIG_ESP_WIFI_DYNAMIC_RX_BUFFER_NUM=32
CONFIG_ESP_TASK_WDT_EN=n
CONFIG_ESP_CONSOLE_UART_BAUDRATE=921600
CONFIG_FREERTOS_HZ=1000
```
